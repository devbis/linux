## Documentation/devicetree/bindings/leds/backlight/ti,lm3530.yaml
```yaml
# SPDX-License-Identifier: (GPL-2.0-only OR BSD-2-Clause)
%YAML 1.2
---
$id: http://devicetree.org/schemas/leds/backlight/ti,lm2530.yaml#
$schema: http://devicetree.org/meta-schemas/core.yaml#

title: Texas Instrument LM3530 backlight

maintainers:
  - Ivan Belokobylskiy <belokobylskij@gmail.com>

description: |
  The Texas Instruments LM3530 is white LED backlight.

allOf:
  - $ref: common.yaml#

properties:
  compatible:
    const: ti,lm3530

  enable-gpios:
    description: GPIO to use to enable/disable and dim the backlight.
    maxItems: 1

  default-brightness: true

  max-brightness: true

  ramp-up-ms:
    description: |
        The Run time ramp rates/step are from one current 
        set-point to another after the device has reached its
        initial target set point from turn-on
    minimum: 0
    maximum: 8192

  ramp-down-ms:
    description: |
        The Run time ramp rates/step are from one current
        set-point to another after the device has reached its
        initial target set point from turn-on
    minimum: 0
    maximum: 8192

  ti,led-mode: true

  ti,current-limit: true

  ti,linear-mapping-mode: true

  ti,no-regulator:
    type: boolean

required:
  - compatible
  - enable-gpios
  - ti,led-mode
  - ti,current-limit
  - ti,linear-mapping-mode
  - max-brightness
  - default-brightness

additionalProperties: false

examples:
  - |
    #include <dt-bindings/gpio/gpio.h>
    backlight {
        compatible = "ti,lm3530";
        enable-gpios = <&gpio2 5 GPIO_ACTIVE_HIGH>;
        default-brightness = <0x10>;
        max-brightness = <0x72>;
        ramp-up-ms = <8>;
        ramp-down-ms = <8>;
        ti,current-limit = <0x17>;
        ti,led-mode = <0>;
        ti,linear-mapping-mode = <0>;
        ti,no-regulator;
    };
```
